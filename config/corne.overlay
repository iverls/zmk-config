&mmv {
    x-input-code = <0x00>;  // REL_X
    y-input-code = <0x01>;  // REL_Y
    time-to-max-speed-ms = <400>;
    acceleration-exponent = <2>;
};

&msc {
    x-input-code = <0x06>;  // REL_HWHEEL
    y-input-code = <0x08>;  // REL_WHEEL
    time-to-max-speed-ms = <500>;
    acceleration-exponent = <1>;
};

